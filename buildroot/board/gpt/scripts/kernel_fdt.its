## buildroot/board/gpt/scripts/kernel_fdt.its
```
/dts-v1/;

/ {
	description = "Simple image with single Linux kernel and FDT blob";	
	#address-cells = <2>;

	images{

		kernel@gpt {
			 description = "GPT Linux kernel";
			 data = /incbin/("../../../output/images/vmlinux.bin");
			 type = "kernel";
			 arch = "gpt";
			 os = "linux";
			 compression = "none";
			 load = <0x2 0x00010000>;
			 entry = <0x2 0x00010000>;
/*
			hash@1 {
				algo = "crc32";
			};
			hash@2 {
				algo = "sha1";
			};
*/
		};

		fdt@gpt	{
			description = "Flattened Device Tree blob";
			data = /incbin/("../../../output/images/fdt.dtb");
			type = "flat_dt";
			arch = "gpt";
			compression = "none";
		};
	};

	configurations {
		default = "conf@gpt";	
		conf@gpt {
		       description = "Boot Linux kernel with FDT blob";
		       kernel = "kernel@gpt";
		       fdt = "fdt@gpt";
		};
	};

};
```
